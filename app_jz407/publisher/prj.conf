## CMakeLists.txt
```
cmake_minimum_required(VERSION 3.20.0)
find_package(Zephyr REQUIRED HINTS $ENV{ZEPHYR_BASE})
project(zenoh_pico_publisher)

include(ExternalProject)
include(CMakePrintHelpers)

zephyr_get_system_include_directories_for_lang_as_string(C ext_system_includes)
zephyr_get_include_directories_for_lang_as_string(C ext_includes)
zephyr_get_compile_definitions_for_lang_as_string(C ext_defs)
zephyr_get_compile_options_for_lang_as_String(C ext_opts)
set(ZENOHPICO_CFLAGS
        "${ZENOHPICO_CFLAGS} ${ext_defs} ${ext_system_includes} ${ext_includes} ${ext_opts} -Wno-array-bounds -Wno-maybe-uninitialized -Wno-stringop-truncation"
)

set(CMAKE_C_STANDARD 17)
set(CMAKE_C_STANDARD_REQUIRED ON)
set(CMAKE_C_EXTENSIONS OFF)

set(ZENOHPICO_SRC_DIR ${CMAKE_CURRENT_SOURCE_DIR}/../../modules/lib/zenoh-pico)
set(ZENOHPICO_BIN_DIR ${CMAKE_BINARY_DIR}/zenoh-pico)
set(ZENOHPICO_INC_DIR ${ZENOHPICO_BIN_DIR}/include)
set(ZENOHPICO_LIB ${ZENOHPICO_BIN_DIR}/lib/libzenohpico.a)

ExternalProject_Add(zenoh-pico-ext
    SOURCE_DIR ${ZENOHPICO_SRC_DIR}
    BINARY_DIR ${ZENOHPICO_BIN_DIR}
    CMAKE_ARGS
        -DWITH_ZEPHYR=ON
        -DBUILD_TOOLS=OFF
        -DBUILD_TESTING=OFF
        -DBUILD_EXAMPLES=OFF
        -DCMAKE_SYSTEM_NAME=Generic
        -DCMAKE_TRY_COMPILE_TARGET_TYPE=STATIC_LIBRARY
        -DCMAKE_C_FLAGS=${ZENOHPICO_CFLAGS}
        -DCMAKE_C_COMPILER=${CMAKE_C_COMPILER}
        -DCMAKE_INSTALL_PREFIX=${ZENOHPICO_BIN_DIR}
        -DZENOH_DEBUG=3
        -DZENOH_LOG=DEBUG
        -DZ_FEATURE_PUBLICATION=1
        # -DZ_FEATURE_UNSTABLE_API=ON
        -DZ_FEATURE_LINK_UDP_MULTICAST=ON
        # -DZ_FEATURE_MULTICAST_TRANSPORT=OFF
        -DFRAG_MAX_SIZE=512
        -DBATCH_UNICAST_SIZE=512
        # # -DBATCH_MULTICAST_SIZE=128
        # -DZ_CONFIG_SOCKET_TIMEOUT=10
        -DZ_FEATURE_SCOUTING=0
        # -DZ_FEATURE_MULTI_THREAD=1
        # -DZ_FEATURE_UNICAST_PEER=1
        # # -DZ_TRANSPORT_LEASE=10000
        # # -DZ_TRANSPORT_LEASE_EXPIRE_FACTOR=3
        # # -DZP_PERIODIC_SCHEDULER_MAX_TASKS=64
    DEPENDS zephyr_interface
    BUILD_BYPRODUCTS ${ZENOHPICO_LIB}
)
add_library(zenohpico_lib STATIC IMPORTED GLOBAL)
add_dependencies(zenohpico_lib zenoh-pico-ext)
set_target_properties(zenohpico_lib PROPERTIES IMPORTED_LOCATION ${ZENOHPICO_LIB})
add_definitions(-DZENOH_ZEPHYR)

target_include_directories(app PRIVATE ${ZENOHPICO_INC_DIR})

target_link_libraries(app PRIVATE zenohpico_lib)

target_sources(app PRIVATE src/main.c)
```

## prj.conf
```kconfig
CONFIG_MAIN_STACK_SIZE=3072
CONFIG_SYSTEM_WORKQUEUE_STACK_SIZE=2048
CONFIG_IDLE_STACK_SIZE=320
CONFIG_CUSTOM_SECTION_MIN_ALIGN_SIZE=32

CONFIG_HEAP_MEM_POOL_SIZE=65536
CONFIG_SYS_HEAP_RUNTIME_STATS=y
CONFIG_SYS_HEAP_LISTENER=y

CONFIG_NEWLIB_LIBC=y
CONFIG_NEWLIB_LIBC_NANO=y
CONFIG_POSIX_API=y

CONFIG_ARM_MPU=n
CONFIG_HW_STACK_PROTECTION=n
CONFIG_INIT_STACKS=y
CONFIG_THREAD_STACK_INFO=y
CONFIG_STACK_USAGE=y
CONFIG_THREAD_ANALYZER=y
CONFIG_THREAD_ANALYZER_AUTO=y

CONFIG_NETWORKING=y
CONFIG_NET_IPV4=y
CONFIG_NET_IPV6=n
CONFIG_NET_TCP=y
CONFIG_NET_UDP=y
CONFIG_NET_SOCKETS=y
CONFIG_NET_SOCKETS_POLL_MAX=4

CONFIG_NET_MAX_CONTEXTS=1
CONFIG_NET_MAX_CONN=1
CONFIG_NET_CONFIG_SETTINGS=y
CONFIG_NET_CONFIG_NEED_IPV4=y
CONFIG_NET_CONFIG_NEED_IPV6=n
CONFIG_NET_DHCPV4=y

CONFIG_NET_L2_ETHERNET=y
CONFIG_ETH_STM32_HAL=y
CONFIG_ENTROPY_GENERATOR=y
CONFIG_ENTROPY_STM32_RNG=y
CONFIG_TEST_RANDOM_GENERATOR=n

CONFIG_NET_BUF_DATA_SIZE=512
CONFIG_NET_BUF_RX_COUNT=12
CONFIG_NET_BUF_TX_COUNT=12
CONFIG_NET_PKT_RX_COUNT=6
CONFIG_NET_PKT_TX_COUNT=6
CONFIG_NET_RX_STACK_SIZE=1536
CONFIG_NET_TX_STACK_SIZE=1536

CONFIG_NET_TCP_MAX_SEND_WINDOW_SIZE=512
CONFIG_NET_TCP_MAX_RECV_WINDOW_SIZE=512
CONFIG_NET_TCP_TIME_WAIT_DELAY=1
CONFIG_NET_TCP_CHECKSUM=y

CONFIG_LOG=n
CONFIG_NET_LOG=n
CONFIG_NET_STATISTICS=n

CONFIG_POSIX_THREAD_THREADS_MAX=5
```

## src/main.c
```c
#include <stdio.h>
#include <unistd.h>
#include <zenoh-pico.h>
#include <zephyr/kernel.h>
#include <zephyr/sys/mem_stats.h>
#include <zephyr/sys/sys_heap.h>

#include <zephyr/net/net_if.h>

// Uncomment if you have network problems

// /*
void restart_network_interface(void) {
  struct net_if *iface = net_if_get_default();

  if (iface) {
    net_if_down(iface);
    k_msleep(500);
    net_if_up(iface);
  }
}
// */


int main(void) {
  static z_owned_session_t s;
  while (true) {
    printk("\n--- Zenoh-Pico Configuration Check ---\n");
    printk("Z_FRAG_MAX_SIZE:        %d bytes\n", Z_FRAG_MAX_SIZE);
    printk("Z_BATCH_UNICAST_SIZE:   %d bytes\n", Z_BATCH_UNICAST_SIZE);

    k_msleep(5000);
    z_owned_config_t config;
    z_config_default(&config);
    zp_config_insert(z_loan_mut(config), Z_CONFIG_MODE_KEY, "client");
    zp_config_insert(z_loan_mut(config), Z_CONFIG_CONNECT_KEY, "tcp/192.168.8.220:7447");
    zp_config_insert(z_loan_mut(config), Z_CONFIG_MULTICAST_SCOUTING_KEY, "false");

    if (z_open(&s, z_move(config), NULL) < 0) {
      printk("Unable to open session!\n");
      z_drop(z_move(s));
      restart_network_interface();
      k_msleep(500);
      continue;
    }

    zp_start_read_task(z_loan_mut(s), NULL);
    zp_start_lease_task(z_loan_mut(s), NULL);

    printk("Session opened!\n");

    z_owned_publisher_t pub_str;

    z_view_keyexpr_t ke_str;
    z_view_keyexpr_from_str_unchecked(&ke_str, "example/zenoh-pico-pub");

    if (z_declare_publisher(z_loan(s), &pub_str, z_loan(ke_str), NULL) < 0) {
      printk("Unable to declare publisher for string topic!\n");
      continue;
    }

    printk("Ok!\n");
    char hello[] = "Hello world!";
    while (true) {
      z_owned_bytes_t payload;
      z_bytes_copy_from_str(&payload, hello);

      if (z_publisher_put(z_loan(pub_str), z_move(payload), NULL) < 0) {
        printk("Send failed! zenohd might be down.\n");
        break;
      }
      printk("Send!\n");
      k_msleep(1000);
    }
    printk("Closing Zenoh Session...");
    z_drop(z_move(pub_str));

    z_drop(z_move(s));
    printk("OK!\n");
  }
  return 0;
}
```

## src/main copy.c
```c
#include <stdio.h>
#include <unistd.h>
#include <zenoh-pico.h>
#include <zephyr/kernel.h>
#include <zephyr/sys/mem_stats.h>
#include <zephyr/sys/sys_heap.h>

#include <zephyr/net/net_if.h>

// Uncomment if you have network problems

/*
void restart_network_interface(void) {
  struct net_if *iface = net_if_get_default();

  if (iface) {
    net_if_down(iface);
    k_msleep(500);
    net_if_up(iface);
  }
}
*/


int main(void) {
  static z_owned_session_t s;
  while (true) {
    printk("\n--- Zenoh-Pico Configuration Check ---\n");
    printk("Z_FRAG_MAX_SIZE:        %d bytes\n", Z_FRAG_MAX_SIZE);
    printk("Z_BATCH_UNICAST_SIZE:   %d bytes\n", Z_BATCH_UNICAST_SIZE);

    k_msleep(5000);
    z_owned_config_t config;
    z_config_default(&config);
    zp_config_insert(z_loan_mut(config), Z_CONFIG_MODE_KEY, "client");
    zp_config_insert(z_loan_mut(config), Z_CONFIG_CONNECT_KEY, "tcp/192.168.8.220:7447");
    zp_config_insert(z_loan_mut(config), Z_CONFIG_MULTICAST_SCOUTING_KEY, "false");

    if (z_open(&s, z_move(config), NULL) < 0) {
      printk("Unable to open session!\n");
      z_drop(z_move(s));
      // restart_network_interface();
      k_msleep(500);
      continue;
    }

    printk("Session opened!\n");

    z_owned_publisher_t pub_str;

    z_view_keyexpr_t ke_str;
    z_view_keyexpr_from_str_unchecked(&ke_str, "example/zenoh-pico-pub");

    if (z_declare_publisher(z_loan(s), &pub_str, z_loan(ke_str), NULL) < 0) {
      printk("Unable to declare publisher for string topic!\n");
      continue;
    }

    printk("Ok!\n");
    char hello[] = "Hello world!";
    uint64_t start_time, end_time, duration;
    zp_read_options_t opts = { .single_read = true };
    while (true) {
      z_owned_bytes_t payload;
      z_bytes_copy_from_str(&payload, hello);

      start_time = k_ticks_to_us_near64(k_uptime_ticks());
      
      if (zp_read(z_loan_mut(s), &opts) < 0) {
        printk("Connection lost detected in background tasks!\n");
        break;
      }

      end_time = k_ticks_to_us_near64(k_uptime_ticks());
      duration = end_time - start_time;
      printk("Latencia de procesamiento READ: %llu us (%.3f ms)\n", 
            duration, (double)duration / 1000.0);

      start_time = k_ticks_to_us_near64(k_uptime_ticks());

      if (zp_send_keep_alive(z_loan_mut(s), NULL) < 0) {
        printk("Connection lost detected in background tasks!\n");
        break;
      }

      end_time = k_ticks_to_us_near64(k_uptime_ticks());
      duration = end_time - start_time;
      printk("Latencia de procesamiento KEEP ALIVE: %llu us (%.3f ms)\n", 
            duration, (double)duration / 1000.0);

      if (z_publisher_put(z_loan(pub_str), z_move(payload), NULL) < 0) {
        printk("Send failed! zenohd might be down.\n");
        break;
      }
      printk("Send!\n");
      k_msleep(1000);
    }
    printk("Closing Zenoh Session...");
    z_drop(z_move(pub_str));

    z_drop(z_move(s));
    printk("OK!\n");
  }
  return 0;
}
```
