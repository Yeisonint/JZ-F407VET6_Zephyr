## app_jz407/ssd1316/drivers/display/Kconfig
```kconfig
# SSD1316 display controller configuration options

# Copyright (c) 2026 Yeison Suarez
# SPDX-License-Identifier: Apache-2.0

menuconfig SSD1316
	bool "SSD1316 display driver"
	default y
	depends on DT_HAS_SOLOMON_SSD1316FB_ENABLED
	select I2C if $(dt_compat_on_bus,$(DT_COMPAT_SOLOMON_SSD1316FB),i2c)
	select SPI if $(dt_compat_on_bus,$(DT_COMPAT_SOLOMON_SSD1316FB),spi)
	help
	  Enable driver for SSD1316 display driver.

if SSD1316

config SSD1316_DEFAULT_CONTRAST
	int "SSD1316 default contrast"
	default 128
	range 0 $(UINT8_MAX)
	help
	  SSD1316 default contrast.

endif # SSD1316
```

## app_jz407/west.yml
```yaml
manifest:

  self:
    path: .

  remotes:
    - name: zephyrproject-rtos
      url-base: https://github.com/zephyrproject-rtos

  projects:
    - name: zephyr
      remote: zephyrproject-rtos
      revision: v4.3.0
      path: zephyr
      import:
        name-allowlist:
          - cmsis
          - cmsis_6
          - cmsis-dsp
          - cmsis-nn
          - hal_stm32
          - hal_st
          - stm32-mw
          - mbedtls
          - littlefs
          - nanopb
          - picolibc
          - mcuboot
          - zcbor
          - lvgl
```

## boards/arm/JZ_F407VET6/Kconfig.defconfig
```kconfig
if BOARD_JZ_F407VET6

config BOARD
	default "BOARD_JZ_F407VET6"

if NETWORKING

config NET_L2_ETHERNET
	default y

config ETH_STM32_HAL
	default y

endif # NETWORKING

endif
```

## boards/arm/JZ_F407VET6/board.yml
```yaml
board:
  name: JZ_F407VET6
  full_name: STM32F407VET6 Industrial Board
  vendor: custom
  socs:
    - name: stm32f407xx
```
