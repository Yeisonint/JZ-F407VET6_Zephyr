## CMakeLists.txt
```
cmake_minimum_required(VERSION 3.20.0)
# set(DTC_OVERLAY_FILE "${CMAKE_CURRENT_SOURCE_DIR}/app.overlay")
find_package(Zephyr REQUIRED HINTS $ENV{ZEPHYR_BASE})
project(i2c_scanner)

include(ExternalProject)
include(CMakePrintHelpers)

zephyr_get_system_include_directories_for_lang_as_string(C ext_system_includes)
zephyr_get_include_directories_for_lang_as_string(C ext_includes)
zephyr_get_compile_definitions_for_lang_as_string(C ext_defs)
zephyr_get_compile_options_for_lang_as_String(C ext_opts)

set(CMAKE_C_STANDARD 17)
set(CMAKE_C_STANDARD_REQUIRED ON)
set(CMAKE_C_EXTENSIONS OFF)

target_sources(app PRIVATE src/main.c)
```

## prj.conf
```kconfig
CONFIG_I2C=y
CONFIG_I2C_GPIO=y
CONFIG_PRINTK=y

CONFIG_LOG=y
CONFIG_LOG_MODE_IMMEDIATE=y
CONFIG_I2C_LOG_LEVEL_DBG=y


CONFIG_I2C=y
CONFIG_I2C_GPIO=y
CONFIG_DISPLAY=y
CONFIG_SSD1306=y
```

## app.overlay
```dts
/ {
    i2c_sw: i2c_gpio_0 {
        compatible = "gpio-i2c"; 
        status = "okay";

        scl-gpios = <&gpioa 6 (GPIO_PULL_UP | GPIO_OPEN_DRAIN)>;
        sda-gpios = <&gpioa 5 (GPIO_PULL_UP | GPIO_OPEN_DRAIN)>;

        clock-frequency = <100000>; 

        #address-cells = <1>;
        #size-cells = <0>;
    };
};
```

## src/main.c
```c
#include <zephyr/kernel.h>
#include <zephyr/device.h>
#include <zephyr/drivers/i2c.h>
#include <stdio.h>

int main(void)
{
    const struct device *i2c_dev = DEVICE_DT_GET(DT_NODELABEL(i2c_sw));

    if (!device_is_ready(i2c_dev)) {
        printk("Error: Software I2C bus not ready. Check pull-ups and pin configuration.\n");
        return 0;
    }
    printk("Starting I2C bus scan (Software Bit-bang)...\n");

    for (uint8_t addr = 0x01; addr < 0x7F; addr++) {
        struct i2c_msg msgs[1];
        uint8_t dst;

        msgs[0].buf = &dst;
        msgs[0].len = 0;
        msgs[0].flags = I2C_MSG_WRITE | I2C_MSG_STOP;

        int ret = i2c_transfer(i2c_dev, msgs, 1, addr);

        if (ret == 0) {
            printk("  - Device found at address: 0x%02X\n", addr);
        }
    }
    printk("Scan finished.\n");

    while (1) {
        k_msleep(1000);
    }
}
```
